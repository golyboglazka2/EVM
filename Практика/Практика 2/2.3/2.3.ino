/* ЧАСТЬ3: Используя библиотеку AmperkaFET и последовательный порт (Serial) реализовать управление 
набором силовых ключей (P-FET и N-FET). Шина SPI.*/

// Подключаем необходимые библиотеки
#include <SPI.h>          // Библиотека для работы с интерфейсом SPI
#include <AmperkaFET.h>   // Библиотека для работы с силовыми ключами
#include <sstream>        // Библиотека для работы со строками
#include <iostream>       // Библиотека для работы с потоками ввода/вывода


FET mosfet(D17, 2); // Создаем объект mosfet с указанными параметрами

void setup() {
  mosfet.begin();      // Инициализируем mosfet
  Serial.begin(9600);  // Инициализируем последовательную связь

  // Отправляем инструкцию по вводу команды
  Serial.write("Введите команду в формате: [МОДУЛЬ КЛЮЧ УРОВЕНЬ] например:\n0 3 1\nдля включения третьего ключа на нулевом модуле\n");
}

void loop() {
  if (Serial.available()) {             // Если есть доступные данные в последовательной связи
    std::stringstream ss;
    ss << Serial.readString().c_str();  // Считываем строку из Serial
    uint32_t modul, key, i;             // Объявляем переменные для хранения данных
    int level;                          // Объявляем переменную для хранения уровня
    ss >> modul >> key >> i;            // Извлекаем значения из строки

    if (i > 0)
      level = HIGH;  // Если i > 0, устанавливаем уровень HIGH
    else
      level = LOW;   // В противном случае устанавливаем уровень LOW

    if (modul > 1)
      modul = 255;   // Если modul > 1, устанавливаем modul = 255

    if (key > 7)
      key = 255;     // Если key > 7, устанавливаем key = 255

    mosfet.digitalWrite(modul, key, level);  // Устанавливаем уровень для ключа на модуле
  }
}

